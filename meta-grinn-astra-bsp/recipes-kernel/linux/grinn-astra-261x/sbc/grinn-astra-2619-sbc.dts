// SPDX-License-Identifier: (GPL-2.0-only OR MIT)
/*
 * Copyright (C) 2026 Grinn sp. z o.o.
 */

/dts-v1/;

#include "sl2619.dtsi"
#include "grinn-astra-2619-som.dtsi"
#include "grinn-astra-261x-sbc.dtsi"

/ {
	model = "Grinn AstraSBC-2619";
	compatible = "grinn,grinn-astra-2619-sbc", "syna,sl2619";
};
